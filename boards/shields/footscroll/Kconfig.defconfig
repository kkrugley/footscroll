## config/west.yml
```yaml
manifest:
  remotes:
    - name: zmkfirmware
      url-base: https://github.com/zmkfirmware
  projects:
    - name: zmk
      remote: zmkfirmware
      revision: v0.1
      import: app/west.yml
  board-root: config/boards
  shield-root: config/boards/shields
  self:
    path: config
```
